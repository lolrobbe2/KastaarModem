## Kconfig
```kconfig
    
menu "Kastaar Modem"
    if !PPP_SUPPORT || !ESP_MODEM_URC_HANDLER
        comment " WARNING: PPP_SUPPORT and ESP_MODEM_URC_HANDLER must be enabled for KastaarModem to function."
    endif

    config KASTAAR_ENABLE_SOCKETS
        bool "Enable Socket functionality"
        default y
        help
            Enable socket functions for the Kastaar Modem.

    if KASTAAR_ENABLE_SOCKETS
        menu "Sockets"
            comment "the minimal functions can only send/ receive 1500 bytes at a time!"

            config KASTAAR_ENABLE_SEND_MINIMAL
                bool "enable minimal send (1500 bytes)"
                default y
                help
                    enable Socket send functions in the interface
            
            config KASTAAR_ENABLE_RECEIVE_MINIMAL
                bool "enable minimal send (1500 bytes)"
                default y
                help
                    enable the minimal receive functions in the interface
            
            config KASTAAR_ENABLE_RECEIVE_FULL
                bool "enable full receive (receive > 1500 bytes)"
                default y
                depends on KASTAAR_ENABLE_RECEIVE_MINIMAL
                help
                    enable the full receive functions in the interface to receive larger payloads then 1500 bytes.
        endmenu
    endif

    config KASTAAR_ENABLE_NVM
        bool "Enable NVM funtionality (Non Volatile Memory)"
        default y

    config KASTAAR_ENABLE_TLS
        bool "Enable SSL/TLS functionality"
        default y
        help
            Enable the SSL/TLS interface.
            
        depends on KASTAAR_ENABLE_NVM
endmenu
```
